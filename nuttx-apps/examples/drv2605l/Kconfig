## nuttx-apps/examples/drv2605l/Kconfig
```kconfig
#
# For a description of the syntax of this configuration file,
# see the file kconfig-language.txt in the NuttX tools repository.
#

config EXAMPLES_DRV2605L
	tristate "DRV2605L haptic driver example"
	default n
	depends on FF_DRV2605L
	---help---
		Enable the DRV2605L example

if EXAMPLES_DRV2605L

config EXAMPLES_DRV2605L_PROGNAME
	string "Program name"
	default "drv2605l"
	---help---
		This is the name of the program that will be used when the NSH ELF
		program is installed.

config EXAMPLES_DRV2605L_PRIORITY
	int "DRV2605L task priority"
	default 100

config EXAMPLES_DRV2605L_STACKSIZE
	int "DRV2605L stack size"
	default DEFAULT_TASK_STACKSIZE

endif
```

## nuttx-apps/examples/lab04si/Kconfig
```kconfig
#
# For a description of the syntax of this configuration file,
# see the file kconfig-language.txt in the NuttX tools repository.
#

config EXAMPLES_LAB04SI
	tristate "Lab04 SI"
	default n
    depends on GRAPHICS_LVGL
	---help---
		Lab04 skel for Embedded Systems

if EXAMPLES_LAB04SI

config EXAMPLES_LAB04SI_PROGNAME
	string "Program name"
	default "lab04si"
	---help---
		This is the name of the program that will be used when the NSH ELF
		program is installed.

config EXAMPLES_LAB04SI_PRIORITY
	int "lab04si task priority"
	default 100

config EXAMPLES_LAB04SI_STACKSIZE
	int "lab04si stack size"
	default 16384

endif
```

## nuttx-apps/hacktorwatch-rev2/main/Kconfig
```kconfig
#
# For a description of the syntax of this configuration file,
# see the file kconfig-language.txt in the NuttX tools repository.
#

config HACKTORWATCH_REV2
	tristate "Hacktorwatch second revision demo"
	default n
	depends on ARCH_BOARD_HACKTORWATCH
	---help---
		Test app for Hacktorwatch rev2

if HACKTORWATCH_REV2

config HACKTORWATCH_REV2_PROGNAME
	string "Program name"
	default "hacktorwatch"
	---help---
		This is the name of the program that will be used when the NSH ELF
		program is installed.

config HACKTORWATCH_REV2_PRIORITY
	int "hacktorwatch_main task priority"
	default 100

config HACKTORWATCH_REV2_STACKSIZE
	int "hacktorwatch_main stack size"
	default 16384 # LVGL Demo stack size

endif
```
